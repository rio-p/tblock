## conf/layer.conf
```bitbake
#
# Copyright (C) u-blox
#
# For additional copyright information see the LICENSE file in the root of this meta layer.
#

# We have a conf and classes directory, append to BBPATH
BBPATH .= ":${LAYERDIR}"

# We have a recipes directory, add to BBFILES
BBFILES += "${LAYERDIR}/recipes*/*/*.bb ${LAYERDIR}/recipes*/*/*.bbappend"

BBFILE_COLLECTIONS += "meta-ublox-modules"
BBFILE_PATTERN_meta-ublox-modules := "^${LAYERDIR}/"
BBFILE_PRIORITY_meta-ublox-modules = "10"

#LAYERVERSION_meta-ublox-modules = "1"
LAYERSERIES_COMPAT_meta-ublox-modules = "morty pyro rocko sumo thud warrior"

LICENSE_PATH += "${LAYERDIR}/files/additional-licenses"

LULA_DL_URL ?= "http://example.com/placeholder/u-blox/deliverables/NDA/elula/"
LULA_DL_PARAMS ?= ""

PREFERRED_RPROVIDER_ella-w1-driver ?= "ella-w1-driver-automotive"
PREFERRED_VERSION_ella-w1-driver-automotive ?= "W14.44.42.p2-M4X14540"
PREFERRED_VERSION_ella-w1-driver-industrial ?= "W14.66.35.p65-M3X14539"
PREFERRED_VERSION_ella-w1-mfg ?= "1.2.7.51-14.0.34.p4"

PREFERRED_RPROVIDER_emmy-w1-driver ?= "emmy-w1-driver-sdiouart"
PREFERRED_VERSION_emmy-w1-driver-sdiouart ?= "15.44.19.p19-C4X15632"
PREFERRED_VERSION_emmy-w1-driver-sdiosdio ?= "15.68.19.p22-C4X15635"
PREFERRED_VERSION_emmy-w1-mfg ?= "2.0.0.89-15.2.7.p69"
PREFERRED_VERSION_emmy-w1-labtool ?= "2.0.0.89-15.2.7.p69"

PREFERRED_RPROVIDER_lily-w1-driver ?= "lily-w1-driver-sdio"
PREFERRED_VERSION_lily-w1-driver-sdio ?= "14.68.36.p139-C4X14635"
PREFERRED_VERSION_lily-w1-driver-usb ?= "14.68.36.p131-C4X14616"
PREFERRED_VERSION_lily-w1-mfg ?= "2.0.0.92-14.1.36.p59"
PREFERRED_VERSION_lily-w1-labtool ?= "2.0.0.92-14.1.36.p59"

PREFERRED_RPROVIDER_jody-w1-driver ?= "jody-w1-driver-pcie"
PREFERRED_VERSION_jody-w1-driver-pcie ?= "89359-2019-03-08"
PREFERRED_VERSION_jody-w1-driver-sdio ?= "89359-2019-03-08"
PREFERRED_VERSION_jody-w1-driver-fmac ?= "4.14.77-2019_0503"
PREFERRED_VERSION_jody-w1-nvrams ?= "20181218"

PREFERRED_RPROVIDER_jody-w2-driver ?= "jody-w2-driver-sdiouart"
PREFERRED_VERSION_jody-w2-driver-sdio ?= "W16.68.10.p33-C4X16651"
PREFERRED_VERSION_jody-w2-driver-sdiouart ?= "W16.68.1.p195-C4X16623"
PREFERRED_VERSION_jody-w2-mfg ?= "1.0.0.164-16.80.205.p164"
PREFERRED_VERSION_jody-w2-labtool ?= "1.0.0.146-16.80.205.p146"

PREFERRED_RPROVIDER_jody-w3-driver ?= "jody-w3-driver-pcieuart"
PREFERRED_VERSION_jody-w3-driver-pcieuart ?= "17.68.0.p137-MXM4X17137"
PREFERRED_VERSION_jody-w3-driver-sdio ?= "17.68.0.p137-MXM4X17137"
PREFERRED_VERSION_jody-w3-driver-sdiouart ?= "17.68.0.p56-MX4X17045"
PREFERRED_VERSION_jody-w3-mfg ?= "2.0.0.72-A0-17.80.200.p135"

PREFERRED_RPROVIDER_theo-p1-driver ?= "theo-p1-driver-usb"
PREFERRED_VERSION_theo-p1-driver-usb ?= "13.2_5.13.46139"

PREFERRED_RPROVIDER_vera-p1-driver ?= "vera-p1-driver-llc-remote"
PREFERRED_VERSION_vera-p1-driver-llc-remote ?= "15.0.0"
BBMASK += "vera-p1-driver-llc-remote_15.*\.bbappend"

PREFERRED_RPROVIDER_vera-p3-firmware ?= "vera-p3-firmware"
PREFERRED_VERSION_vera-p3-firmware ?= "2.0.8"

PREFERRED_RPROVIDER_vera-p3-host-tools ?= "vera-p3-host-tools"
PREFERRED_VERSION_vera-p3-host-tools ?= "2.0.8"

PREFERRED_RPROVIDER_vera-p3-driver ?= "vera-p3-driver-sdio"
PREFERRED_VERSION_vera-p3-driver-sdio ?= "2.0.8"
```
